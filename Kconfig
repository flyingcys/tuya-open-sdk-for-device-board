## Kconfig
```kconfig
menu "configure esp32"
    config OPERATING_SYSTEM
        int
        default 98
        ---help---
            100     /* LINUX */
            98      /* RTOS */        
            3       /* Non-OS */

    config ENABLE_WIFI
        bool "ENABLE_WIFI --- use wifi to connect"
        default y

    config ENABLE_WATCHDOG
        bool "ENABLE_WATCHDOG --- use watchdog"
        default y

    config ENABLE_BLUETOOTH
        bool "ENABLE_BLUETOOTH --- use bluetooth to connect"
        select ENABLE_BT_SERVICE
        select ENABLE_NIMBLE
        default y

    config LITTLE_END
        int
        default 1
        ---help---
            0       /* big endian */
            1       /* little endian */

    endmenu
```
